## firmware/main/Kconfig.projbuild
```kconfig
menu "Keyword spotting"

    menu "Microphone (I2S)"
        config KWS_I2S_PORT
            int "I2S port"
            range 0 1
            default 0

        config KWS_I2S_BCLK_GPIO
            int "SCK / BCLK GPIO"
            default 26

        config KWS_I2S_WS_GPIO
            int "WS / LRCLK GPIO"
            default 25

        config KWS_I2S_DIN_GPIO
            int "SD / data-in GPIO"
            default 33
            help
                Do not use GPIO16/17 on WROVER modules: they are wired to PSRAM.

        config KWS_MIC_SLOT_LEFT
            bool "Microphone on left slot (L/R pin to GND)"
            default y
            help
                INMP441 with L/R tied to GND transmits in the left slot. If the
                device only ever hears silence, try toggling this option.

        config KWS_MIC_SHIFT
            int "Right shift from 32-bit I2S word to 16-bit PCM"
            range 8 20
            default 14
            help
                16 keeps the top 16 bits (unity gain). Each step lower doubles the
                gain. 14 (x4) suits an INMP441 at arm's length.

        config KWS_MIC_DC_BLOCK
            bool "Remove DC offset"
            default y

        config KWS_AUDIO_BUFFER_MS
            int "Audio buffer between capture and inference (ms, PSRAM)"
            range 200 4000
            default 1000

        config KWS_AUDIO_TASK_PRIORITY
            int "Capture task priority"
            default 12
    endmenu

    menu "Inference"
        config KWS_INFERENCE_TASK_PRIORITY
            int "Inference task priority"
            default 10

        config KWS_TENSOR_ARENA_KB
            int "Tensor arena size (KB, internal RAM)"
            range 16 160
            default 48

        config KWS_INFERENCE_EVERY_N_FRAMES
            int "Run the model every N feature frames (20 ms each)"
            range 1 10
            default 3

        config KWS_DETECTION_THRESHOLD_PCT
            int "Detection threshold (% averaged probability)"
            range 50 99
            default 93
            help
                Default chosen with ml/tune_detector.py; see ml/reports/detector_sweep.json.
                Can be changed at runtime with the set_threshold MQTT command.

        config KWS_AVERAGE_WINDOW_MS
            int "Averaging window (ms)"
            default 800

        config KWS_MIN_RESULTS
            int "Minimum results in the window before deciding"
            default 2

        config KWS_SUPPRESSION_MS
            int "Minimum time between detections (ms)"
            default 1200

        config KWS_MODEL_REQUIRE_SIGNATURE
            bool "Require ECDSA signature on models in flash slots"
            default y
            help
                Models delivered over the air must be signed with the key whose public
                half is components/kws_model/keys/model_signing_pub.pem.
    endmenu

    menu "Board"
        config KWS_BUTTON_GPIO
            int "Button GPIO (active low)"
            default 0

        config KWS_FACTORY_RESET_HOLD_MS
            int "Hold time to forget Wi-Fi and re-enter provisioning (ms)"
            default 5000

        config KWS_LED_GPIO
            int "Status LED GPIO (-1 to disable)"
            default 2

        config KWS_LED_ACTIVE_HIGH
            bool "LED is active high"
            default y
    endmenu

    menu "Connectivity"
        config KWS_PROV_DEV_USERNAME
            string "BLE provisioning username (development fallback)"
            default "kws"

        config KWS_PROV_DEV_PASSWORD
            string "BLE provisioning password (development fallback)"
            default "kws-dev-pass"
            help
                Used only when the fctry partition has no per-device SRP6a verifier.
                Leave empty for production so unprovisioned devices refuse to pair.

        config KWS_MQTT_BROKER_URI
            string "MQTT broker URI (development fallback)"
            default ""
            help
                e.g. mqtts://192.168.1.10:8883. Factory data (broker_uri) takes precedence.

        config KWS_ALLOW_INSECURE_MQTT
            bool "Allow plain mqtt:// (development only)"
            default n

        config KWS_SNTP_SERVER
            string "SNTP server"
            default "pool.ntp.org"

        config KWS_HEALTH_INTERVAL_S
            int "Health telemetry interval (s)"
            range 10 3600
            default 60

        config KWS_SELFTEST_CONNECT_TIMEOUT_S
            int "After a firmware update, roll back if MQTT is not reached within (s)"
            default 300
    endmenu

endmenu
```

## firmware/sdkconfig.defaults
```kconfig
# ---- Target: ESP32-WROVER-E N16R8 -----------------------------------------
CONFIG_IDF_TARGET="esp32"
CONFIG_ESPTOOLPY_FLASHSIZE_16MB=y
CONFIG_ESPTOOLPY_FLASHMODE_DIO=y
CONFIG_ESPTOOLPY_FLASHFREQ_40M=y
CONFIG_ESP_DEFAULT_CPU_FREQ_MHZ_240=y

# ---- Partitions ------------------------------------------------------------
CONFIG_PARTITION_TABLE_CUSTOM=y
CONFIG_PARTITION_TABLE_CUSTOM_FILENAME="partitions.csv"
CONFIG_PARTITION_TABLE_OFFSET=0x10000

# ---- PSRAM (8 MB; 4 MB mappable on classic ESP32) --------------------------
CONFIG_SPIRAM=y
CONFIG_SPIRAM_USE_MALLOC=y
CONFIG_SPIRAM_MALLOC_ALWAYSINTERNAL=4096
CONFIG_SPIRAM_MALLOC_RESERVE_INTERNAL=49152
CONFIG_SPIRAM_TRY_ALLOCATE_WIFI_LWIP=y
CONFIG_SPIRAM_ALLOW_BSS_SEG_EXTERNAL_MEMORY=y
CONFIG_MBEDTLS_EXTERNAL_MEM_ALLOC=y

# ---- Bluetooth: NimBLE, BLE only (provisioning) ----------------------------
CONFIG_BT_ENABLED=y
CONFIG_BT_NIMBLE_ENABLED=y
CONFIG_BTDM_CTRL_MODE_BLE_ONLY=y
CONFIG_BT_NIMBLE_MAX_CONNECTIONS=1
CONFIG_BT_NIMBLE_MEM_ALLOC_MODE_EXTERNAL=y
CONFIG_ESP_COEX_SW_COEXIST_ENABLE=y

# ---- Wi-Fi provisioning ----------------------------------------------------
CONFIG_WIFI_PROV_BLE_FORCE_ENCRYPTION=y
CONFIG_WIFI_PROV_AUTOSTOP_TIMEOUT=30
CONFIG_ESP_PROTOCOMM_SUPPORT_SECURITY_VERSION_0=n
CONFIG_ESP_PROTOCOMM_SUPPORT_SECURITY_VERSION_1=n
CONFIG_ESP_PROTOCOMM_SUPPORT_SECURITY_VERSION_2=y

# ---- TLS / certificates ----------------------------------------------------
CONFIG_MBEDTLS_CERTIFICATE_BUNDLE=y
CONFIG_MBEDTLS_CERTIFICATE_BUNDLE_DEFAULT_CMN=y
CONFIG_ESP_TLS_INSECURE=n

# ---- OTA and robustness ----------------------------------------------------
CONFIG_BOOTLOADER_APP_ROLLBACK_ENABLE=y
CONFIG_BOOTLOADER_APP_ANTI_ROLLBACK=n
CONFIG_ESP_HTTPS_OTA_DECRYPT_CB=n
CONFIG_ESP_TASK_WDT_EN=y
CONFIG_ESP_TASK_WDT_TIMEOUT_S=10
CONFIG_ESP_TASK_WDT_PANIC=y
CONFIG_ESP_INT_WDT=y
CONFIG_ESP_BROWNOUT_DET=y
CONFIG_ESP_SYSTEM_PANIC_PRINT_REBOOT=y
CONFIG_ESP_COREDUMP_ENABLE_TO_FLASH=y
CONFIG_ESP_COREDUMP_DATA_FORMAT_ELF=y

# ---- FreeRTOS / build ------------------------------------------------------
CONFIG_FREERTOS_HZ=1000
CONFIG_COMPILER_OPTIMIZATION_PERF=y
CONFIG_COMPILER_CXX_EXCEPTIONS=n
CONFIG_COMPILER_STACK_CHECK_MODE_NORM=y
CONFIG_APP_PROJECT_VER_FROM_CONFIG=n

# ---- Logging ---------------------------------------------------------------
CONFIG_LOG_DEFAULT_LEVEL_INFO=y
CONFIG_LOG_TIMESTAMP_SOURCE_SYSTEM=y

# ---- Application ---------------------------------------------------------
CONFIG_ESP_MAIN_TASK_STACK_SIZE=8192
```
